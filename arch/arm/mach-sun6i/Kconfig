## arch/arm/mach-sun6i/Kconfig
```kconfig
choice
	prompt "Allwinner Platform Type"
	depends on ARCH_SUN6I || ARCH_SUN7I
	default AW_PLATFORM_EVB

config AW_FPGA_V4_PLATFORM
       bool "FPGAv4 board"
       help
         Support for Allwinner's FPGAv4 board

config AW_FPGA_V7_PLATFORM
       bool "FPGAv7 board"
       help
         Support for Allwinner's FPGAv4 board

config AW_ASIC_EVB_PLATFORM
       bool "EVB board"
       help
         Support for Allwinner's EVB board

endchoice

config SUNXI_SYSFS
	bool "Allwinner SUNXI Sysfs"
    depends on ARCH_SUN6I
	help
	  Support /sys/class/sunxi for kernel.

config SUNXI_POWER_SCENE
	bool "support scene change notify"
    depends on SUNXI_SYSFS
	help
	  Support /sys/class/sunxi/power/scene for kernel.
```

## drivers/char/dma_test/Kconfig
```kconfig
#
# sun7i dma test configuration.
#

config DMA_TEST_DRIVER
	tristate "sun7i dma test driver"
	default y
	help
	This is sun7i dma test driver.
```

## drivers/char/gpio_test/Kconfig
```kconfig
#
# sun7i gpio test configuration.
#

config SUN7I_GPIO_TEST
	bool "sun7i gpio test driver"
	default n
	help
	Nothing help.
```

## drivers/char/sunxi_mem_test/Kconfig
```kconfig
#
# sunxi continous physic memory test.
#

config SUNXI_MEM_TEST
	bool "sunxi continous physic memory allocator test driver"
	default y
	depends on SUNXI_PHYS_MEM_ALLOCATOR
	help
	Nothing help.
```

## drivers/gpu/ion/Kconfig
```kconfig
menuconfig ION
	tristate "Ion Memory Manager && Ion for sunxi"
	select GENERIC_ALLOCATOR
	help
	  Chose this option to enable the ION Memory Manager and SUNXI ion.

config ION_SUNXI_CARVEOUT_SIZE
	int "memory size(in MB) for sunxi carveout ion heap."
	default 360
	depends on ION
	help
	  Select memory size for sunxi carveout ion heap, the memory is used by gpu.
	  Examples:
		     100 => reserve 100M bytes memory for carveout heap.
		     230 => reserve 230M bytes memory for carveout heap.
```

## drivers/misc/sw_3g_module/Kconfig
```kconfig
#
# softwinner 3G module driver.
#

menuconfig SW_3G_MODULE
    tristate "softwinner 3G module driver"
    help
        softwinner 3G module driver

choice

    prompt "3G modem support"
    depends on SW_3G_MODULE
    help
        3G modem slecet.

config HUAWEI_MU509
    boolean "huawei mu509"
    help
        huawei mu509 modem support.

config YUGA_CWM600
    boolean "yuga cwm600"
    help
        yuga cwm600 modem support.

config OVIPHONE_EM55
    boolean "Oviphone em55"
    help
        Oviphone em55 modem support.

endchoice
```

## drivers/mmc/mmc-pm/Kconfig
```kconfig
#
# MMC/SD host controller drivers
#

comment "SDIO Card Power Management Drivers"

config MMC_SDIOPM
	tristate "Winner's SDIO Power Management Support"
	depends on MMC
	help
	  This selects Allwinner SDIO Card Power Management support.
	  All power related gpio control here.
```

## drivers/net/ethernet/sun6i/Kconfig
```kconfig
config NET_VENDOR_SUNXI
	bool "Sun6i gmac devices"
	default y
	depends on HAS_IOMEM
	---help---
	The gmac device of sun6i platform soc.

if NET_VENDOR_SUNXI

config SUNXI_GMAC
	tristate "Sun6i platform 10/100/1000Mbps Ethernet driver"
	depends on HAS_IOMEM && NET_VENDOR_SUNXI
	select NET_CORE
	select MII
	select PHYLIB
	select CRC32
	---help---
	  This is the driver for the Sun6i Ethernet.
endif

if SUNXI_GMAC

config GMAC_SCRIPT_SYS
	bool "Use sunxi platform script"
	depends on SUNXI_GMAC
	default y
	---help---
	 The GMAC gpio request and control by the script of sunxi platform.
	 Select it, by script. If not, ioremap by drivers itself.

config GMAC_CLK_SYS
	bool "Clock use system interface"
	depends on SUNXI_GMAC
	default y
	---help---
	 It select the clock controler is system or the driver itself.
	 If you want to use the system interface, select it. If not, the
	 driver will control the clock by ioremap.

choice
	prompt "Select the DMA TX/RX descriptor operating modes"
	depends on SUNXI_GMAC
	---help---
	  This driver supports DMA descriptor to operate both in dual buffer
	  (RING) and linked-list(CHAINED) mode. In RING mode each descriptor
	  points to two data buffer pointers whereas in CHAINED mode they
	  points to only one data buffer pointer.

config GMAC_RING
	bool "Enable Descriptor Ring Mode"

config GMAC_CHAINED
	bool "Enable Descriptor Chained Mode"

endchoice

endif # NET_VENDOR_SUNXI
```

## drivers/net/ethernet/sun7i/Kconfig
```kconfig
config NET_VENDOR_SUN7I
	bool "Sun7i emac devices"
	default y
	depends on HAS_IOMEM
	---help---
	The emac device of sun7i platform soc.

if NET_VENDOR_SUN7I

config SUN7I_EMAC
	tristate "Sun7i platform 1G Ethernet driver"
	depends on HAS_IOMEM && NET_VENDOR_SUN7I
	select NET_CORE
	select MII
	select PHYLIB
	select CRC32
	---help---
	  This is the driver for the Sun7i Ethernet.

endif # NET_VENDOR_SUN6I
```

## drivers/net/wireless/bcmdhd/Kconfig
```kconfig
config BCMDHD
	tristate "Broadcom 4329/30 wireless cards support"
	depends on MMC
	default n
	---help---
	  This module adds support for wireless adapters based on
	  Broadcom 4329/30 chipset.

config BCMDHD_FW_PATH
	depends on BCMDHD
	string "Firmware path"
	default "/system/vendor/modules/fw_bcm40181a2.bin"
	---help---
	  Path to the firmware file.

config BCMDHD_NVRAM_PATH
	depends on BCMDHD
	string "NVRAM path"
	default "/system/vendor/modules/nvram_ap6210.txt"
	---help---
	  Path to the calibration file.

config BCMDHD_WEXT
	bool "Enable WEXT support"
	depends on BCMDHD && CFG80211 = n
	select WIRELESS_EXT
	select WEXT_PRIV
	help
	  Enables WEXT support

config DHD_USE_SCHED_SCAN
	bool "Use CFG80211 sched scan"
	depends on BCMDHD && CFG80211
	default n
	---help---
	  Use CFG80211 sched scan

choice
    depends on BCMDHD
    prompt "Interrupt type"
config BCMDHD_OOB
	depends on BCMDHD
	bool "Out-of-Band Interrupt"
	---help---
		Interrupt through WL_HOST_WAKE.
config BCMDHD_SDIO_IRQ
	depends on  BCMDHD
	bool "In-Band Interrupt"
	default y
	---help---
		Interrupt through SDIO DAT[1]
endchoice
```

## drivers/power/axp_power/Kconfig
```kconfig
menuconfig AW_AXP
	bool "AXP Power drivers"
	depends on REGULATOR
	default n
	---help---
	  This option allows you to select AXP power driver

if AW_AXP

choice
	prompt "AXP PMU type"
	default AW_AXP22

config AW_AXP18
	bool "AXP18 driver"
	---help---
	  AXP18 driver

config AW_AXP19
	bool "AXP19 driver"
	---help---
	  AXP19 driver

config AW_AXP20
	bool "AXP20 driver"
	---help---
	  AXP20 driver

config AW_AXP22
	bool "AXP22 driver"
	---help---
	  AXP22 driver

endchoice

config AXP_CHARGEINIT
	bool "AXP initial charging environment set"
	default y

config AXP_CHGCHANGE
	bool "AXP charging current set when suspend\resume\shutdown"
	default y

config AXP_TWI_USED
	bool "AXP use twi as transfer channel"
	default n
	
endif # !AW_AXP
```
